## Kconfig
```kconfig
# Pacman Dongle Module Kconfig

menuconfig ZMK_DONGLE_PACMAN
  bool "Pacman Dongle Module"
  default n
  help
    Enable the Pacman Dongle module for ZMK. This provides a
    Pacman-themed status screen and game on an ST7789P3 172x320 display.
```

## boards/shields/pacman_adapter/Kconfig.shield
```kconfig
# Pacman Dongle Adapter Shield Kconfig

config SHIELD_PACMAN_ADAPTER
  def_bool $(shields_list_contains,pacman_adapter)

config ZMK_DONGLE_PACMAN_BUZZER
  bool "Buzzer support"
  default n
  help
    Enable buzzer support on the dongle.
```

## dts/bindings/behaviors/zmk,behavior-dongle-action.yaml
```yaml
description: Dongle Action Behavior — dispatches Pacman display/game actions

compatible: "zmk,behavior-dongle-action"

include: base.yaml

properties:
  label:
    type: string
    required: true
  "#binding-cells":
    type: int
    required: true
    const: 1
```

## dts/bindings/display/sitronix,st7789p3.yaml
```yaml
# Copyright (c) 2024
# SPDX-License-Identifier: MIT

description: ST7789P3 320x172 display via SPI

compatible: "sitronix,st7789p3"

include: [spi-device.yaml]

properties:
  width:
    type: int
    default: 320
  height:
    type: int
    default: 172
  madctl:
    type: int
    default: 0x20
  colmod:
    type: int
    default: 0x55
  inversion:
    type: boolean
  x-offset:
    type: int
    default: 0
  y-offset:
    type: int
    default: 0
  reset-gpios:
    type: phandle-array
    required: true
  dc-gpios:
    type: phandle-array
    required: true
  bl-gpios:
    type: phandle-array
    required: false
```
